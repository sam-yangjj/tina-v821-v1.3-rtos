## lichee/rtos-components/aw/Kconfig
```kconfig
source "components/common/aw/ringbuffer/Kconfig"
source "components/common/aw/amp_app/Kconfig"
source "components/common/aw/rpbuf/Kconfig"
source "components/common/aw/pm/Kconfig"
source "components/common/aw/virt_log/Kconfig"
source "components/common/aw/multi_console/Kconfig"
source "components/common/aw/sys_config_script/Kconfig"
source "components/common/aw/console/Kconfig"
source "components/common/aw/network/Kconfig"
source "components/common/aw/ostest/Kconfig"
source "components/common/aw/trace_event/Kconfig"
source "components/common/aw/flash_read/Kconfig"
source "components/common/aw/rpbuff_uart/Kconfig"
source "components/common/aw/iobox/Kconfig"
source "components/common/aw/sunxi-rpc/Kconfig"
source "components/common/aw/rpcfs/Kconfig"
```

## lichee/rtos-components/aw/amp_app/Kconfig
```kconfig
menuconfig COMPONENTS_AMP_APP
	bool "AMP Application"
	default n
	help
	  Enable some applications which is used on AMP situation.
	  Some of them is based on OpenAMP framework.

if COMPONENTS_AMP_APP

menuconfig COMPONENTS_AMP_HW_WATCHDOG
	bool "AMP Hardware Watchdog"
	default n
	help
	  When we use the hardware watchdog on AMP, we don't need to init watchdog.
	  We only need to setup the timeout of watchdog timer and feed watchdog.
	  If you want feed watchdog and setup the timeout on your private code,
	  you need to disable this configuration.

if COMPONENTS_AMP_HW_WATCHDOG

config AMP_HW_WATCHDOG_TIMEOUT
	int "The Timeout of AMP Hardware Watchdog(unit: second)"
	default 2

config AMP_HW_WATCHDOG_FEED_INTERVAL
	int "The Interval to Feed AMP Hardware Watchdog(unit: ms)"
	default 100

config AMP_HW_WATCHDOG_THREAD_PRIORITY
	int "The Thread Priority to Feed AMP Hardware Watchdog"
	default 31

endif #COMPONENTS_AMP_HW_WATCHDOG

menuconfig COMPONENTS_AMP_USER_MEMORY
	bool "AMP User Memory"
	default n
	select AMP_USER_MEMORY_0
	help
	  AMP User Memory for remoteproc(slave).
	  Currently it only support loading custom data form partition.

if COMPONENTS_AMP_USER_MEMORY

config DUMP_ALL_AMP_USER_MEMORY_INFO
	bool "Dump All AMP User Memory Information after System Starting"
	default n

config AMP_USER_MEMORY_DT_NODE_NAME_PREFIX
	string "AMP User Memory Device Tree Node Name Prefix"
	default "e907_user_mem" if ARCH_RISCV
	default "dsp_user_mem" if ARCH_DSP

config AMP_USER_MEMORY_0
	bool "Enable AMP User Memory 0"
	default y

config AMP_USER_MEMORY_1
	bool "Enable AMP User Memory 1"
	default n

config AMP_USER_MEMORY_2
	bool "Enable AMP User Memory 2"
	default n

config AMP_USER_MEMORY_3
	bool "Enable AMP User Memory 3"
	default n

endif #COMPONENTS_AMP_USER_MEMORY

menuconfig COMPONENTS_AMP_USER_RESOURCE
	bool "AMP User Resource"
	default n
	select AMP_USER_RESOURCE_0
	help
	  AMP User Resource for remoteproc(slave).
	  Currently it only support loading custom data form partition.

if COMPONENTS_AMP_USER_RESOURCE

config AMP_USER_RESOURCE_0
	bool "Enable AMP User Resource 0"
	default y

if AMP_USER_RESOURCE_0

config AMP_USER_RESOURCE_0_PARTITION_NAME
	string "AMP User Resource 0 Partition Name"
	default "riscv0"

config AMP_USER_RESOURCE_0_DATA_LEN
	int "AMP User Resource 0 Data Length"
	default 256

endif

config AMP_USER_RESOURCE_1
	bool "Enable AMP User Resource 1"
	default n

if AMP_USER_RESOURCE_1

config AMP_USER_RESOURCE_1_PARTITION_NAME
	string "AMP User Resource 1 Partition Name"
	default "riscv1"

config AMP_USER_RESOURCE_1_DATA_LEN
	int "AMP User Resource 1 Data Length"
	default 256

endif

config AMP_USER_RESOURCE_2
	bool "Enable AMP User Resource 2"
	default n

if AMP_USER_RESOURCE_2

config AMP_USER_RESOURCE_2_PARTITION_NAME
	string "AMP User Resource 2 Partition Name"
	default "riscv2"

config AMP_USER_RESOURCE_2_DATA_LEN
	int "AMP User Resource 2 Data Length"
	default 256

endif

config AMP_USER_RESOURCE_3
	bool "Enable AMP User Resource 3"
	default n

if AMP_USER_RESOURCE_3

config AMP_USER_RESOURCE_3_PARTITION_NAME
	string "AMP User Resource 3 Partition Name"
	default "riscv3"

config AMP_USER_RESOURCE_3_DATA_LEN
	int "AMP User Resource 3 Data Length"
	default 256

endif

endif #COMPONENTS_AMP_USER_RESOURCE

menuconfig COMPONENTS_AMP_TIMESTAMP
	bool "AMP Timestamp"
	default n
	select AMP_TS_DEV_0
	help
	  Allwinner AMP timestamp component, it provide timestamp
	  with same timebase on AMP situation.

if COMPONENTS_AMP_TIMESTAMP

config AMP_TS_DEV_0
	bool "Enable AMP Timestamp Device 0"
	default y

if AMP_TS_DEV_0

config AMP_TS_DEV_0_COUNTER_REG_ADDR
	hex "AMP Timestamp Device 0 Counter Register Base Address"
	default 0

config AMP_TS_DEV_0_COUNT_FREQ
	int "AMP Timestamp Device 0 Count Frequency(unit: Hz)"
	default 24000000

config AMP_TS_DEV_0_COUNTER_TYPE
	int "AMP Timestamp Device 0 Counter Type"
	default 0

config AMP_TS_TEST_CMD
	bool "AMP Timestamp Test cmd"
	default n

endif

endif #COMPONENTS_AMP_TIMESTAMP

endif #COMPONENTS_AMP_APP
```

## lichee/rtos-components/aw/flash_read/Kconfig
```kconfig
menu "AW Flash read Compenents"

config COMPONENTS_AW_FLASH_READ
    bool "Tina Flash read"
    depends on ARCH_SUN300IW1
    default n
    help
        If unsure, say N.

if COMPONENTS_AW_FLASH_READ

choice COMPONENTS_AW_FLASH_READ_TYPE
	prompt "Select load storage type"
	default COMPONENTS_AW_FLASH_READ_SPINOR

	config COMPONENTS_AW_FLASH_READ_SPINOR
		bool "spinor"
	config COMPONENTS_AW_FLASH_READ_EMMC
		bool "emmc"
	config COMPONENTS_AW_FLASH_READ_SDNAND
		bool "sdnand"
endchoice

config COMPONENTS_AW_FLASH_WRITE
	bool "Flash Write Support"
	depends on COMPONENTS_AW_FLASH_READ_SPINOR
	default n

config COMPONENTS_AW_FLASH_GPT_OFFSET
	int "Flash gpt offset"
	default 2016

config COMPONENTS_AW_FLASH_BOOTPKG_OFFSET
	int "Flash bootpackage offset"
	default 128

config COMPONENTS_AW_FLASH_DEBUG
	bool "Flash Read Debug"
	default n
	help
		If unsure, say N.

config COMPONENTS_AW_FLASH_USE_HWLOCK
	bool "Tina Flash Use Hwlock"
	depends on COMPONENTS_AW_FLASH_READ_SPINOR
	default n
	help
		If unsure, say N.

config COMPONENTS_AW_FLASH_HWLOCK_IDX
	int "Tina Flash Use Hwlock Idx"
	depends on COMPONENTS_AW_FLASH_USE_HWLOCK
	default 16
endif
endmenu
```

## lichee/rtos-components/aw/network/Kconfig
```kconfig
menu "aw network"
config COMPONENTS_TCPIP
	bool "tcp ip adapter"
	select DRIVERS_RFKILL
	default n

source components/common/aw/network/service/Kconfig

menuconfig COMPONENTS_LOW_POWER_SELECT
	bool "low power application selection"
	default n
	if COMPONENTS_LOW_POWER_SELECT
		choice
			prompt "select low power application type"
			config COMPONENTS_LOW_POWER_APP
				bool "low power"
			config COMPONENTS_TUYA_LOW_POWER_APP
				bool "tuya low power app"
		endchoice

		if COMPONENTS_LOW_POWER_APP
			choice
				default COMPONENTS_LOW_POWER_APP_TCP
				prompt "low power keepalive version"
			config COMPONENTS_LOW_POWER_APP_TCP
				bool "low power keepalive by tcp"
			config COMPONENTS_LOW_POWER_APP_MQTT
				bool "low power keepalive by mqtt"
				select COMPONENTS_MQTTC
				select COMPONENTS_COREMQTT_2_3_1
			config COMPONENTS_LOW_POWER_WLAN_FW_TCP
				bool "low power keepalive tcp by wlan fw"
				depends on DRIVERS_XRADIO
			endchoice

			choice
				default COMPONENTS_LOW_POWER_STRATEGY_STANDBY_NOT_WAIT_SER_REPLY
				prompt "low power keepalive demo strategy use"
			config COMPONENTS_LOW_POWER_STRATEGY_STANDBY_WAIT_SER_REPLY
				bool "low power strategy standby wait ser reply"
			config COMPONENTS_LOW_POWER_STRATEGY_STANDBY_NOT_WAIT_SER_REPLY
				bool "low pwoer strategy standby not wait ser reply"
			config COMPONENTS_LOW_POWER_STRATEGY_DISABLE
				bool "low pwoer strategy disable"
			endchoice

			config COMPONENTS_LOW_POWER_APP_MQTT_CAPACITY_READ
				bool "capacity read in low power keepalive mqtt demo"
				default n
				depends on COMPONENTS_LOW_POWER_APP_MQTT

			config COMPONENTS_LOW_POWER_APP_NOTIFY
				bool "low power demo pm notify"
				default n
			config COMPONENTS_LOW_POWER_RPMSG_HEART
				bool "low power demo rpmsg heart"
				default n

			if COMPONENTS_LOW_POWER_APP_TCP
				config COMPONENTS_LOW_POWER_APP_RUN_WITH_WERTC_EXIT
					bool "low power demo run when cpux demo_video_webrtc exit"
					default n
				config COMPONENTS_LOW_POWER_APP_RTC_WATCH_DOG
					bool "low power demo rtc watchdog"
					default n
					help
					  low power demo rtc watchdog, use for low power app

				config COMPONENTS_LOW_POWER_PIR
					bool "low power demo pir"
					default n
					select DRIVERS_RTC
					select DRIVERS_WUPIO

				config COMPONENTS_LOW_POWER_POWERKEY
					bool "low power demo powerkey"
					default n
					select DRIVERS_WUPIO
			endif
		endif

		if COMPONENTS_TUYA_LOW_POWER_APP
			config TUYA_RTC_WATCH_DOG
				bool "tuya rtc watchdog"
				default n
				help
				  tuya rtc watchdog, use for tuya lowpower app
		endif
	endif
endmenu
```

## lichee/rtos-components/aw/network/service/Kconfig
```kconfig
menu "service"
config COMPONENTS_SERVICE_DHCPS
	bool "dhcps demo"
	depends on (WLAN_AP || !DRIVERS_XRADIO)
	depends on COMPONENTS_LWIP
	default n
	help
		this is dhcps command example

config COMPONENTS_SERVICE_IPERF
	bool "iperf demo"
	default n
	select NEWLIBC_NANO_SCANF_FLOAT
	help
		this is iperf command example

config COMPONENTS_SERVICE_PING
	bool "ping demo"
	depends on COMPONENTS_PING
	default n
	help
		this is ping command example

if COMPONENTS_PAHOMQTT
config COMPONENTS_SERVICE_MQTT
	bool "mqtt demo"
	default n
	help
		this is mqtt command example
endif

if COMPONENTS_MBEDTLS_2_16_0
config COMPONENTS_SERVICE_MBEDTLS
	bool "mbedtls demo"
	default n
	help
		this is mbedtls command example
endif

if COMPONENTS_HTTPCLIENT
config COMPONENTS_SERVICE_HTTPCLIENT
	bool "httpc demo"
	default n
	help
		this is httpclient command example
endif

endmenu
```

## lichee/rtos-components/aw/ostest/Kconfig
```kconfig
menu "Os Testcase Support"

config COMPONENTS_OSTEST
    bool "Os Testcase"
    default n
    help
        Tina RTOS Os Testcase support.

if COMPONENTS_OSTEST

config COMPONENTS_OSTEST_JPEGPERF
    bool "JPEGPERF Testcase"
    default n

config COMPONENTS_OSTEST_HARDWARE_PERF
    bool "HARDWARE performance"
    select DRIVERS_TIMER
    default n

config COMPONENTS_OSTEST_RTT_MEMHEAP
    bool "MEMHEAP Testcase"
    default n
source "components/common/aw/ostest/fpu_test/Kconfig"

source "components/common/aw/ostest/kernel_test/Kconfig"
source "components/common/aw/ostest/osal_test/Kconfig"
source "components/common/aw/ostest/cpp_test/Kconfig"
source "components/common/aw/ostest/irqnest_test/Kconfig"
source "components/common/aw/ostest/memheap_test/Kconfig"
endif

endmenu
```

## lichee/rtos-components/aw/ostest/cpp_test/Kconfig
```kconfig
menuconfig COMPONENTS_OSTEST_CPP
	bool "C++ Environment Testcase"
	select CPP_11_TEST
	depends on COMPONENT_CPLUSPLUS

if COMPONENTS_OSTEST_CPP

config CPP_11_TEST
    bool "C++ 11 Testcase"
    default n

endif
```

## lichee/rtos-components/aw/ostest/fpu_test/Kconfig
```kconfig
menuconfig COMPONENTS_OSTEST_FPU
	bool "FPU Testcase"

if COMPONENTS_OSTEST_FPU

config FPU_GENERAL_REG_SIZE
	int "FPU General Register Size(unit: byte)"
	default 4
	help
		Generally, if the platform support double precision, the size of FPU general register
		is 8 byte, otherwise it's 4 byte. PS: On T-HEAD RISC-V platform, if this configuration
		you provided is different with toolchian, the test command will print warning.

config FPU_GENERAL_REG_CNT
	int "FPU General Register Count"
	range 1 32
	default 32

config FPU_CTX_TEST
	bool "FPU Context Save/Restore Test"
	default n

config FPU_CTX_TEST_WITH_ROUNDING_MODE
	bool "FPU Context Save/Restore Test With Rounding Mode"
	default n if ARCH_ARM
	default y if ARCH_RISCV
	depends on FPU_CTX_TEST
	help
		Float point rounding mode controll the rounding rule of float point arithmetic.
		Due to this test currently depends on fegetround API and fesetround API which is
		declared in fenv.h, so we need to turn off this configuration when the system
		don't support these APIs.

config E90X_START_INTERRUPT_ID
	int "E90x Start Interrupt ID"
	default 235
	depends on FPU_CTX_TEST
	depends on ARCH_RISCV_E906 || ARCH_RISCV_E907
	help
		Start interrupt id when executing FPU context test in interrupt environment.

config SHOW_C906_FPU_CTX_STATISTICS_INFO
	bool "Provide command to print C906 FPU context statistics info"
	depends on RECORD_C906_FPU_CTX_STATISTICS
	default n

endif
```

## lichee/rtos-components/aw/ostest/irqnest_test/Kconfig
```kconfig
menuconfig COMPONENTS_OSTEST_IRQNEST
	bool "Irqnest Testcase"
	depends on ARCH_RISCV_INTERRUPT_NEST

if COMPONENTS_OSTEST_IRQNEST

config IRQNEST_TEST_HW_IRQID_START
	int "Hardware interrupt id used for irq nest test"
	default -32
	help
		The configured interrupt id and the interrupt id following
		it will be used for irq nest test.

config IRQNEST_OSTEST_GENERAL_CTX_CMP
	bool "General regs and Control regs Save/Restore test"
	default n
	help
		General regs and Control regs Save/Restore data compare.
		Relies on arch interrupt entry code support this function.

if IRQNEST_OSTEST_GENERAL_CTX_CMP
config IRQNEST_GENERAL_REG_SIZE
	int "General Register Size"
	default 4

config IRQNEST_GENERAL_REG_CNT
	int "General Register Count"
	default 32

config IRQNEST_TEST_CTX_CONTENT_DEBUG
	bool "print General and Control regs Save/Restore data"
	default n
endif

config	IRQNEST_FPU_TEST
	bool "FPU and FPU Context Save/Restore test"
	default n

if IRQNEST_FPU_TEST
config IRQNEST_FPU_GENERAL_REG_SIZE
	int "FPU General Register Size"
	default 4

config IRQNEST_FPU_GENERAL_REG_CNT
	int "FPU General Register Count"
	default 32
endif#IRQNEST_FPU_TEST

endif
```

## lichee/rtos-components/aw/ostest/kernel_test/Kconfig
```kconfig
menuconfig COMPONENTS_OSTEST_KERNEL
	bool "Kernel Testcase"

if COMPONENTS_OSTEST_KERNEL

config OS_SCHEDULE_TEST
    bool "OS Schedule Testcase"
    default n

config OS_TICK_FREQ_TEST
    bool "OS Tick Frequency Testcase"
    default n

config OS_PTHREAD_TEST
    bool "OS Pthread Testcase"
    default n

endif
```

## lichee/rtos-components/aw/ostest/memheap_test/Kconfig
```kconfig
if COMPONENTS_OSTEST_RTT_MEMHEAP

config NUM_HEAPS
    int "Heaps number"
    default 2
    help
        The amount of memory heap should not be too large

config STACK_SIZE
    int "Heaps Size bytes"
    default 131072
    help
        The memory heap size should not be too large

config MAX_ALLOC_SIZE
    int "Maximum Allocation Size acquiesce 128 bytes"
    default 128
    help
        The number of memory blocks should not be too large

config TEST_ITERATIONS
    int "Number of Test Iterations acquiesce 1000"
    default 1000
    help
        Number of iterations * The memory block size cannot exceed the size of a single memory heap

config ALIGNMENT
    int "Alignment acquiesce 4"
    default 4
    help
        This option specifies the alignment.
        The value is fixed at 4 and cannot be changed.

endif
```
