## lichee/rtos-components/aw/ostest/osal_test/Kconfig
```kconfig
menuconfig COMPONENTS_OSTEST_OSAL
    bool "Osal Testcase"

if COMPONENTS_OSTEST_OSAL

config COMPONENTS_OSTEST_OSAL_TIME
    bool "Time Testcase"
    default n

if COMPONENTS_OSTEST_OSAL_TIME
config COMPONENTS_OSTEST_OSAL_TIME_ACCURACY
    int "Time accuracy, unit us"
    default 1
    help
      This precision is the minimum delay time that the delay API can achieve.
      It is used for every platform has different accuracy.
endif

config COMPONENTS_OSTEST_OSAL_TIMER
    bool "Timer Testcase"
    default n

config COMPONENTS_OSTEST_OSAL_SEM
    bool "Sem Testcase"
    default n

config COMPONENTS_OSTEST_OSAL_QUEUE
    bool "Queue Testcase"
    default n

config COMPONENTS_OSTEST_OSAL_THREAD
    bool "Thread Testcase"
    default n

config COMPONENTS_OSTEST_OSAL_WAITQUEUE
    bool "Waitqueue Testcase"
    default n

config COMPONENTS_OSTEST_OSAL_WORKQUEUE
    bool "Workqueue Testcase"
    default n

config COMPONENTS_OSTEST_OSAL_CACHE
    bool "Cache Testcase"
    default n

config COMPONENTS_OSTEST_OSAL_MUTEX
    bool "Mutex Testcase"
    default n

config COMPONENTS_OSTEST_OSAL_CFG
    bool "Cfg Testcase"
    default n

config COMPONENTS_OSTEST_OSAL_MEM
    bool "Mem Testcase"
    default n

config COMPONENTS_OSTEST_OSAL_EVENT
    bool "Event Testcase"
    default n

config COMPONENTS_OSTEST_OSAL_ATOMIC
    bool "Atomic Testcase"
    default n
	help
		This testcase include spinlock & critical

config COMPONENTS_OSTEST_OSAL_INTERRUPT
    bool "Interrupt Testcase"
    default n
	help
		This testcase include irq & interrupt

endif
```

## lichee/rtos-components/aw/pm/Kconfig
```kconfig
menuconfig COMPONENTS_PM
    bool "PowerManager Support"
    default n
    help
      Support standby and hibernation mode.

if COMPONENTS_PM
if COMPONENTS_AMP_PM || ARCH_SUN20IW2P1
choice COMPONENTS_PM_CORE
    prompt "Select core"
    default COMPONENTS_PM_CORE_M33   if ARCH_ARM_ARMV8M
    default COMPONENTS_PM_CORE_RISCV if ARCH_RISCV_RV64
    default COMPONENTS_PM_CORE_DSP   if ARCH_DSP
    help
      This option determines which core the PM run on.
      Usually used to divide the interaction between cores in the PM process.

    config COMPONENTS_PM_CORE_M33
        bool "M33"
        help
          the code for m33

    config COMPONENTS_PM_CORE_DSP
        bool "DSP"
        help
          the code for dsp

    config COMPONENTS_PM_CORE_RISCV
        bool "RISCV"
        help
          the code for riscv
endchoice
endif

menuconfig COMPONENTS_PM_WAKESRC
    bool "List of wakeup source types"
    default y
    depends on ARCH_SUN20IW2P1
    help
	List of wakesrc on the core.
	Some wakeup sources may need to register with the specific core.
	It is only used to detemine whether it is a wakeup source for the the driver that needs it.
	Configuration is n does not mean the wakesrc is not supported.

if COMPONENTS_PM_WAKESRC
config PM_WAKESRC_WUPIO
    bool "WUPIO wakesrc"
    default y
    help
      WUPIO wakesrc

config PM_WAKESRC_WUPTIMER
    bool "WUPTIMER wakesrc"
    default y
    help
      WUPTIMER wakesrc

config PM_WAKESRC_ALARM
    bool "RTC  Alarm wakesrc"
    default y
    help
      RTC alarm wakesrc

config PM_WAKESRC_LPUART
    bool "LPUART wakesrc"
    default n
    help
      LPUART wakesrc

config PM_WAKESRC_GPADC
    bool "GPADC wakesrc"
    default n
    help
      GPADC wakesrc

config PM_WAKESRC_MAD
    bool "MAD wakesrc"
    default n
    help
      MAD wakesrc

config PM_WAKESRC_WLAN
    bool "WLAN wakesrc"
    default n
    help
       WLAN wakesrc

config PM_WAKESRC_BLE
    bool "BLE wakesrc"
    default n
    help
       BLE wakesrc

config PM_WAKESRC_GPIO
    bool "GPIO wakesrc"
    default n
    help
       GPIO wakesrc
endif

comment "Special Config"
config ARCH_PM_FIRMWARE_BASE
    hex "PM Firmware's space base"
    default 0x02000000
    #depends on COMPONENTS_PM_CORE_M33
    help
      The space must be placed on SRAM.
      This parameter takes effect only after
      COMPONENTS_PM_CORE_M33 is enabled

config ARCH_PM_FIRMWARE_SIZE
    hex "PM Firmware's space size"
    default 0x21c00
    #depends on COMPONENTS_PM_CORE_M33
    help
      The recommended value is not less than 64K.

config RTOS_FW_RESERVED_MEM_ADDR
    hex "Rtos firmware reserved memory address"
    default "0x81444000"
    help
      Rtos firmware reserved memory address

config DRAM_POWER_OPEN_DURATION_US
    int "Dram power open dration of us"
    default 500
    help
      Set dram power open duration, because dcdc open will waste time

config PM_SIMULATED_RUNNING
    bool "Simulated on FPGA"
    default n
    help
      Simulates a running environment on the FPGA

config PM_SUBSYS_RISCV_SUPPORT
    bool "support riscv subsys"
    default y
    depends on COMPONENTS_PM_CORE_M33
    help
      Enable riscv subsys support

config PM_SUBSYS_DSP_SUPPORT
    bool "support dsp subsys"
    default n
    depends on COMPONENTS_PM_CORE_M33
    help
      Enable dsp subsys support

config COMPONENTS_PM_TEST_TOOLS
    bool "PM test tools"
    default n
    depends on COMPONENTS_PM
    help
      Enable pm test tools, including pm stress, recording sign and etc.

choice STANDBY_LOAD_STORAGE_TYPE
	prompt "Select standby load storage type"
    default PM_LOAD_STORAGE_TYPE_SPINOR
    depends on COMPONENTS_PM
	help
	  Select storage type which standby bin will load pm boot and rtos.

	config PM_LOAD_STORAGE_TYPE_SPINOR
	bool "SPINOR"
	select COMPONENTS_AW_FLASH_READ
	select COMPONENTS_AW_FLASH_READ_SPINOR
	help
	  Type for spinor.

	config PM_LOAD_STORAGE_TYPE_SPINAND
	bool "SPINAND"
	help
	  Type for spinand.

	config PM_LOAD_STORAGE_TYPE_MMC
	bool "MMC"
	help
	  Type for mmc.
endchoice
config PM_STANDBY_MEMORY
    bool "pm_standby_memory"
    default n
    depends on COMPONENTS_PM
    help
      Enable standby memory manager

config PM_TIME_RECORD
    bool "pm_time_record"
    default n
    depends on COMPONENTS_PM
    help
      Enable pm time record debug

config PM_TIME_RECORD_PLUS
    bool "pm_time_record_plus"
    default n
    depends on PM_TIME_RECORD
    help
      Enable pm time record debug, which record actions start&end moment in order.

config PM_HEAP_RECORD
    bool "pm_heap_record"
    default n
    depends on COMPONENTS_PM
    help
      Enable pm heap record debug

config PM_DISABLE_ALL_LOG
    bool "pm_disable_all_log"
    default n
    depends on COMPONENTS_PM
    help
      Disable all log in suspend and resume

config PM_HEAP_RETAIN
    bool "pm_heap_retain"
    default n
    depends on COMPONENTS_PM
    help
      calculate heap retain space

config PM_DEBUG_BACKTRACE_PERIODICALLY
    bool "pm debug backtrace periodically"
    default n
    depends on COMPONENTS_PM
    help
    	Periodically backtrace the pm process.

config PM_RECORD_STAGE_BY_DEFAULT
    bool "pm record stage by default"
    default n
    depends on COMPONENTS_PM
    help
    	pm record stage to specific regs by default

if ARCH_SUN300IW1
source "components/common/aw/pm/plat_sun300iw1p1/Kconfig"
endif

endif
```

## lichee/rtos-components/aw/pm/plat_sun300iw1p1/Kconfig
```kconfig
menuconfig PM_PLAT_DEBUG
    bool "pm platform debug tools"
    depends on COMPONENTS_PM
    help
      PM platform debug tools.

if PM_PLAT_DEBUG
config PM_DEBUG_POWERON_REGS_SHOW
    bool "pm debug poweron regs show"
    default n
    depends on COMPONENTS_PM
    help
      Perform pm software porcess to record specific register values.

config PM_DEBUG_WATCHDOG_RESET
    bool "pm debug watchdog reset"
    default n
    depends on COMPONENTS_PM
    select DRIVERS_RTC_WATCHDOG
    select DRIVERS_PRCM
    help
    	Enable watchdog when suspend begins and disable watchdog when resume ends.

config PM_DEBUG_WATCHDOG_RESET_TIME
    int "pm debug watchdog reset overtime(seconds)"
    default 10
    depends on PM_DEBUG_WATCHDOG_RESET
    help
    	watchdog overtime setting(seconds).
endif

config PM_PLAT_PATH
    string "pm plat name"
    default "plat_sun300iw1p1"
    depends on COMPONENTS_PM

config SUNXI_VF_2_1
    bool "Set CPU to VF 2_1 (1200MHz/1.00v)"
    default n
    depends on COMPONENTS_PM
    help
        Set CPU to VF 2_1 (1200MHz/1.00v).

config PMC_EN1_FOR_PWRCTRL
    bool "pmc en1 for pwrctrl"
    default y
    depends on COMPONENTS_PM
    help
        pmc en1 for pwrctrl to use

config PMC_EN2_FOR_PWRCTRL
    bool "pmc en2 for pwrctrl"
    default y
    depends on COMPONENTS_PM
    help
        pmc en2 for pwrctrl to use

config PMC_PL6_FOR_PWRCTRL
    bool "pmc pl6 for pwrctrl"
    default y
    depends on COMPONENTS_PM
    help
        pmc pl6 for pwrctrl to use

config PMC_PL7_FOR_PWRCTRL
    bool "pmc pl7 for pwrctrl"
    default n
    depends on COMPONENTS_PM
    help
        pmc pl7 for pwrctrl to use

config RESUME_SENSOR_IN_SRAM
    bool "resume sensor in sram"
    default n
    depends on COMPONENTS_PM
    help
        resume sensor in sram to optimization aov pm time

config PM_DISABLE_RCCAL_IN_HIBERNATION
    bool "pm disable rccal in hibernation"
    default n
    depends on COMPONENTS_PM
    help
        pm disable rccal in hibernation
```

## lichee/rtos-components/aw/rpbuf/Kconfig
```kconfig
menu "RPBuf framework"

config COMPONENTS_RPBUF
	bool
	help
	  The RPBuf (Remote Processor Buffer) framework provides mechanisms to
	  allocate buffers and transmit their references to remote processor.
	  This allows user to exchange large data with remote processor.

config COMPONENTS_RPBUF_SERVICE_RPMSG
	bool "RPMsg-based RPBuf service component"
	select COMPONENTS_RPBUF
	select COMPONENTS_OPENAMP_OPEN_AMP
	default n
	help
	  Say y here to enable support for the RPMsg-based RPBuf service component.
	  This is one kind of RPBuf service backend implemented with RPMsg.

config COMPONENTS_RPBUF_CONTROLLER
	bool "RPBuf controller component"
	select COMPONENTS_RPBUF
	default n
	help
	  Say y here to enable support for the RPBuf controller component.

config AW_RPBUF_PERF_TRACE
	bool "Rpbuf performance trace"
	default n
	depends on COMPONENTS_RPBUF
	depends on COMPONENTS_AMP_TIMESTAMP
	  help
	  It will take up part of buffer to record timestamp when send and receive.

if AW_RPBUF_PERF_TRACE
config RPBUF_AMP_TS_DEV_ID
	int "AMP timestamp device ID"
	default 0

config AW_RPBUF_PERF_DATA_AUTO_DUMP
	bool "Dump performance data automatically after each transmit"
	default n

endif

config COMPONENTS_RPBUF_RESERVED_MEM
	bool "RPBuf reserved memory"
	depends on COMPONENTS_RPBUF && ARCH_RISCV_PMP
	default y
	help
	  RPBuf module need to specify reserved memory for buffer allocation
	  when MPU(eg: PMP hardware in RISC-V) enable. If you don't specify
	  the reserved memory, RPBuf master will use buffer with random address
	  from memory allocator. In this situation, system will possibly crash
	  because of MPU when it send data to remote processor by rpbuf.

if COMPONENTS_RPBUF_RESERVED_MEM
config COMPONENTS_RPBUF_RESERVED_MEM_ADDR
	hex "RPBuf reserved memory addr"
	default 0x42380000
	help
	  We need provide the rpbuf reserved memeory address if MPU(eg: PMP hardware in RISC-V)
	  enable. This config is need to be same with the peer entity of rpbuf communication.

config COMPONENTS_RPBUF_RESERVED_MEM_SIZE
	hex "RPBuf reserved memory size"
	default 0x80000
	help
	  We need provide the rpbuf reserved memeory size if MPU(eg: PMP hardware in RISC-V)
	  enable. This config is need to be same with the peer entity of rpbuf communication.

endif # COMPONENTS_RPBUF_RESERVED_MEM

config COMPONENTS_RPBUF_DEMO
	bool "RPBuf Demo"
	depends on COMPONENTS_MD5
	select COMPONENTS_RPBUF
	default n

endmenu
```

## lichee/rtos-components/aw/rpbuff_uart/Kconfig
```kconfig
config COMPONENTS_RPBUF_UART
	bool "rpbuf uart"
	default n
config RPBUFF_UART_PORT
	int "rpbuff uart port number"
	depends on COMPONENTS_RPBUF_UART
	default 2

config RPBUFF_UART_DEBUG_LOG
	bool "rpbuff uart port debug log"
	depends on COMPONENTS_RPBUF_UART
	default n
```

## lichee/rtos-components/aw/rpcfs/Kconfig
```kconfig
menu "Rpcfs Components Support"

config COMPONENTS_RPCFS
	bool "Tina RTOS Rpcfs"
	default n
	depends on COMPONENTS_AW_RPC_CLIENT
	help
	  Tina RTOS Rpcfs support.

config COMPONENTS_RPCFS_AUTO_MOUNT
	bool "Tina RTOS Rpcfs Auto Mount"
	default y
	depends on COMPONENTS_RPCFS
	help
	  Tina RTOS Rpcfs Auto Mount Flag.

config COMPONENTS_RPCFS_PATH
	string "Tina RTOS Rpcfs Mount Path"
	default "/host"
	depends on COMPONENTS_RPCFS
	help
	  Tina RTOS Rpcfs Mount Path.

config COMPONENTS_RPCFS_DEBUG
	bool "Tina RTOS Rpcfs Debug Info"
	default n
	depends on COMPONENTS_RPCFS

config COMPONENTS_RPCFS_EXPORT_CMD
	bool "Tina RTOS Rpcfs Export Cmd"
	default n
	depends on COMPONENTS_RPCFS

endmenu
```

## lichee/rtos-components/aw/sunxi-rpc/Kconfig
```kconfig
menu "SUNXI RPC Support"

config COMPONENTS_AW_RPC
	tristate "Sunxi Rpc support for Allwinner SoCs"
	depends on DRIVERS_MSGBOX

config COMPONENTS_AW_RPC_CHANNEL
	int "Sunxi Rpc Msgbox Channel"
	depends on COMPONENTS_AW_RPC
	default 1

config COMPONENTS_AW_RPC_CLIENT_MEMBLK_SIZE
	int "Sunxi Rpc Client Memblk Size"
	depends on COMPONENTS_AW_RPC
	default 1024

config COMPONENTS_AW_RPC_CLIENT
	bool "Sunxi Rpc Client support for Allwinner SoCs"
	depends on COMPONENTS_AW_RPC

config COMPONENTS_AW_RPC_CLIENT_MAX_MEMBLK
	int "Sunxi Rpc Client Max Memblk"
	depends on COMPONENTS_AW_RPC_CLIENT
	default 16

config COMPONENTS_AW_RPC_SERVER
	bool "Sunxi Rpc Server support for Allwinner SoCs"
	depends on COMPONENTS_AW_RPC

config COMPONENTS_AW_RPC_SERVER_MAX_CLASS
	int "Sunxi Rpc Server Max Class"
	depends on COMPONENTS_AW_RPC_SERVER
	default 4

config COMPONENTS_AW_RPC_SERVER_MAX_THREAD
	int "Sunxi Rpc Server Max Thread"
	depends on COMPONENTS_AW_RPC_SERVER
	default 4

config COMPONENTS_AW_RPC_DEBUG
	bool "Sunxi Rpc Debug"
	default n

config COMPONENTS_AW_RPC_TEST_CMD
	bool "Export Sunxi Rpc Test Cmd"
	default n

endmenu
```

## lichee/rtos-components/aw/virt_log/Kconfig
```kconfig
menuconfig COMPONENTS_VIRT_LOG
	bool "virtual log"
	default n

if COMPONENTS_VIRT_LOG
config COMPONENTS_VIRT_LOG_SIZE
	int "virt log buffer size(unit:Kb)"
	default 4

config COMMAND_DMESG
    bool "Dmesg Command to show virt log buffer"
	default n

config ULTRA_STANDBY_VIRT_LOG
	bool "enable virt log in ultra standby"
	default n
endif
```

## lichee/rtos-components/thirdparty/Kconfig
```kconfig
source components/common/thirdparty/md5/Kconfig
source components/common/thirdparty/openamp/Kconfig
source components/common/thirdparty/cjson/Kconfig
source components/common/thirdparty/network/Kconfig
source components/common/thirdparty/bluetooth/Kconfig
source components/common/thirdparty/rtt_memheap/Kconfig
source components/common/thirdparty/decompress/Kconfig
source components/common/thirdparty/fs/Kconfig
source components/common/thirdparty/uvoice_keyword_spotting/Kconfig
```

## lichee/rtos-components/thirdparty/cjson/Kconfig
```kconfig
menuconfig COMPONENT_CJSON
    bool "cjson support"
    default n
	if COMPONENT_CJSON
		choice
			default COMPONENTS_C_JSON
			prompt "cjson version"
		config COMPONENTS_C_JSON
			bool "c-json"
		config COMPONENTS_CJSON_1_7_18
			bool "cJSON-1.7.18"
		config COMPONENTS_COREJSON_3_3_0
			bool "coreJSON-3.3.0"
		endchoice
	endif
```

## lichee/rtos-components/thirdparty/decompress/Kconfig
```kconfig
menuconfig COMPONENTS_COMPRESS
	bool "Compress Support"
	default n

if COMPONENTS_COMPRESS
config COMPONENTS_COMPRESS_GZIP
	bool "Gzip Compress"
	default n
config COMPONENTS_COMPRESS_LZMA
	bool "Lzma Compress"
	default n
config COMPONENTS_COMPRESS_BZIP2
	bool "Bzip2 Compress"
	default n
config COMPONENTS_COMPRESS_XZ
	bool "Xz Compress"
	default n
config COMPONENTS_COMPRESS_LZO
	bool "LZO Compress"
	default n
config COMPONENTS_COMPRESS_LZ4
	bool "LZ4 Compress"
	default n
endif
```
