## lichee/rtos/amp-spl/arch/Kconfig
```kconfig
config ARCH_RISCV32
	bool

config ARCH_RISCV64
	bool

config ARCH_RISCV
	bool

config ARCH_CPU_E907
	select ARCH_RISCV32
	select ARCH_RISCV
	bool

config CHIP_PLATFORM
	string
	default "SUN300IW1" if SUN300IW1

config ARCH_PLATFORM
	string
	default "riscv" if ARCH_RISCV32
	default "riscv" if ARCH_RISCV32

choice PLATFORM
	prompt "Sunxi-chip to use"
	help
	the ic we use for build

config ARCH_SUN300IW1
	bool
	select ARCH_CPU_E907
	prompt "AW1882 platform"
endchoice

menu "toolchain config"

config BITS_PER_LONG
	int "bits per long"
	default 32 if ARCH_RISCV32
	default 64 if ARCH_RISCV64

config TOOLCHAIN_PACKAGE
	string "toolchain package"

config TOOLCHAIN_PATH
	string "toolchain path"

config TOOLCHAIN_PREFIX
	string "toolchain prifix"
	default "riscv64-unknown-elf-" if ARCH_RISCV

config TOOLCHAIN_MACH_FLAGS
	string "toolchain mach flags"
	default "-mcmodel=medany -mabi=ilp32d -march=rv32imafdcxthead" if ARCH_CPU_E907

config TOOLCHAIN_LD_FLAGS
	string "toolchain ldflags"
	default "-nostartfiles -nodefaultlibs --gc-sections" if ARCH_RISCV

config ELF_FORMAT
	string
	default "-melf32lriscv" if ARCH_RISCV32
	default "-melf64lriscv" if ARCH_RISCV64

endmenu

if ARCH_RISCV32
menu "riscv config"

config TIMESTAMP_BASE_ADDR
	hex "timestamp base addr"

endmenu
endif
```

## lichee/rtos/amp-spl/board/Kconfig
```kconfig
menu "Board Config"

config RAM_START_ADDRESS
	hex "ram start address"
	help
	  ram start address

config RAM_LENGTH
	hex "ram length"
	default 0x10000
	help
	  ram size

config STACK_SIZE
	hex "stack size"
	default 0x1000
	help
	  stack size

config UART_PORT
	int "uart port"
	default 0

config LOG_LEVEL
	int "log level"
	range 0 1
	default 1
	help
	  0 only printk
	  1 printk and printf

endmenu
```

## lichee/rtos/amp-spl/driver/Kconfig
```kconfig
menu "Device Drivers"

source "driver/pin/Kconfig"

source "driver/intc/Kconfig"

source "driver/uart/Kconfig"

source "driver/pmu/Kconfig"

source "driver/twi/Kconfig"

source "driver/vin/Kconfig"

endmenu
```

## lichee/rtos/amp-spl/driver/intc/Kconfig
```kconfig
menuconfig IRQCHIP_USED
	def_bool y
	prompt "intc used"

if IRQCHIP_USED
choice IRQCHIP_IP
	prompt "Sunxi irqchip to use"
config CLIC_USED
	bool
	prompt "clic used"
endchoice

config IRQ_SOUCE_COUNT
	int "irq source count"
	default 256

if CLIC_USED
config RISCV_CLIC_BASE
	hex "riscv clis reg base"
	default 0
endif
endif
```

## lichee/rtos/amp-spl/driver/pin/Kconfig
```kconfig
menuconfig PIN_USED
	bool "pin used"
	default y

if PIN_USED
choice GPIO_VERSION
	prompt "gpio version"
	help
	  selete gpio driver version

config SUNXI_GPIO_V2
	bool "gpio v2"
endchoice
endif
```

## lichee/rtos/amp-spl/driver/pmu/Kconfig
```kconfig
menuconfig PMU_USED
	def_bool n
	prompt "PMU used"
	depends on TWI_USED

if PMU_USED
config PMU_TWI_ID
	int "pmu twi id"
	default 0

config AXP2101_POWER
	bool "axp2101 driver"
	default n
endif
```
