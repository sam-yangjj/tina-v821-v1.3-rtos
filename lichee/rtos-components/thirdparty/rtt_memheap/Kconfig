## lichee/rtos-components/thirdparty/rtt_memheap/Kconfig
```kconfig
config COMPONENT_RTT_MEMHEAP
	bool "RT-Thread heap memory manager"
	default n
	help
	  This heap memory manager is extracted form RT-Thread memheap module.
	  It provide similar APIs to manage memory.

if COMPONENT_RTT_MEMHEAP

choice
prompt "Memory management strategy"
default RTT_MEMHEAP_USE_SCHEDULER_LOCK
 help
   Choose the memory management strategy for RT-Thread heap memory manager.
config RTT_MEMHEAP_USE_MUTEX_LOCK
	bool "Use mutex lock"
	help
	  Use mutex lock for memory management.
config RTT_MEMHEAP_USE_SCHEDULER_LOCK
	bool "Use scheduler lock"
	help
	  Use task scheduling for memory management.
endchoice

endif
```

## lichee/rtos-components/thirdparty/uvoice_keyword_spotting/Kconfig
```kconfig
config COMPONENTS_KEYWORD_SPOTTING
	bool "keyword spotting by uvoice"
	default n
	help
      support uvoice keyword spotting
```

## lichee/rtos-hal/hal/source/ccu/Kconfig
```kconfig
menu "CCU Driver(Next Generation)"
visible if !DRIVERS_CCMU

config DRIVERS_CCU
	bool "Enable Allwinner Clock Controller Unit Driver(Next Generation)"
	depends on ARCH_SUN300IW1P1
	default n if DRIVERS_CCMU
	default y if !DRIVERS_CCMU

config HAL_TEST_CCU_NG
	bool "enable CCU hal APIs test command"
	depends on DRIVERS_CCU
	default n

endmenu
```

## lichee/rtos-hal/hal/source/chips/Kconfig
```kconfig
menu "CHIPS Devices"

config SUNXI_CHIPS
    bool "enable chips devices"
        default n

endmenu
```

## lichee/rtos-hal/hal/source/dma/Kconfig
```kconfig
menu "DMA Devices"

config DRIVERS_DMA
    bool "enable dma driver"
        default y

config DRIVERS_NDMA
    bool "enable ndma driver"
	depends on DRIVERS_DMA
        default y if ARCH_SUN300IW1

config HAL_TEST_DMA
    bool "enable dma hal APIs test command"
	depends on DRIVERS_DMA
        default n

endmenu
```

## lichee/rtos-hal/hal/source/gpadc/Kconfig
```kconfig
menu "GPADC Devices"

config DRIVERS_GPADC
    bool "enable gpadc driver"
    depends on ARCH_SUN8IW18P1 || ARCH_SUN8IW19 || ARCH_SUN20IW1 || ARCH_SUN8IW20 || ARCH_SUN20IW2 || ARCH_SUN20IW3 || ARCH_SUN300IW1
        default y

config DRIVERS_POWER_PROTECT
    bool "enable power protect driver"
    depends on DRIVERS_GPADC
        default n

config PM_NEED_GPADC
    bool "Need gpadc when pm period"
    depends on DRIVERS_GPADC
        default n

config HAL_TEST_GPADC
    bool "enable gpadc hal APIs test command"
    depends on DRIVERS_GPADC
        default n

endmenu
```

## lichee/rtos-hal/hal/source/hwspinlock/Kconfig
```kconfig
menu "HW SPINLOCK Devices"

config DRIVERS_HWSPINLOCK
	bool "enable hwspinlock driver"
	default n

config HAL_TEST_HWSPINLOCK
	bool "enable hwspinlock hal APIS test command"
	depends on DRIVERS_HWSPINLOCK
	default n

config HWSPINLOCK_CLK_INIT_IN_OTHER_CORE
	bool "enable hwspinlock clk init in other core"
	depends on DRIVERS_HWSPINLOCK
	default n

endmenu
```

## lichee/rtos-hal/hal/source/pwm_ng/Kconfig
```kconfig
menu "SUNXI PWM Devices"
config DRIVERS_SUNXI_PWM
    bool "enable pwm-ng driver"
    depends on ARCH_SUN55IW3 || ARCH_SUN55IW6 || ARCH_SUN300IW1
        default n

config HAL_TEST_SUNXI_PWM
    bool "enable pwm-ng hal APIs test command"
    depends on DRIVERS_SUNXI_PWM
        default n

endmenu
```

## lichee/rtos-hal/hal/source/rtc_watchdog/Kconfig
```kconfig
menu "RTC WATCHDOG Devices"

config DRIVERS_RTC_WATCHDOG
    bool "enable rtc watchdog driver"
	depends on ARCH_SUN300IW1
        default n

config HAL_TEST_RTC_WATCHDOG
    bool "enable rtc watchdog hal APIs test command"
	depends on DRIVERS_RTC_WATCHDOG
	default n

endmenu
```

## lichee/rtos-hal/hal/source/timer/Kconfig
```kconfig
menu "TIMER Devices"

config DRIVERS_TIMER
    bool "enable timer driver"
        default y

config DRIVERS_TIMER_AVS
    bool "enable avs timer driver"
        default n

config DRIVERS_WAKEUP_TIMER
    bool "enable timer wakeup driver"
        default n

config DRIVERS_HTIMER
    bool "enable hrtimer driver"
        default n
choice
    prompt "Configure htimer clk source"
	depends on DRIVERS_HTIMER
	default HTIMER_CLK_SOURCE_BY_CCU

config HTIMER_CLK_SOURCE_BY_CCU
    bool "Configure hrtimer clock source by ccu"

config HTIMER_CLK_SOURCE_BY_TIMER
    bool "Configure hrtimer clock source by prcm"

endchoice

choice
    prompt "Configure htimer clk"
	depends on HTIMER_CLK_SOURCE_BY_TIMER && !ARCH_SUN300IW1
	default HTIMER_CLK_100MHZ

config HTIMER_CLK_200MHZ
    bool "200MHZ"

config HTIMER_CLK_100MHZ
    bool "100MHZ"

config HTIMER_CLK_50MHZ
    bool "50MHZ"

config HTIMER_CLK_25MHZ
    bool "25MHZ"

endchoice

choice
    prompt "Configure htimer clk"
	depends on HTIMER_CLK_SOURCE_BY_TIMER && ARCH_SUN300IW1
	default HTIMER_CLK_96MHZ

config HTIMER_CLK_192MHZ
    bool "192MHZ"

config HTIMER_CLK_96MHZ
    bool "96MHZ"

config HTIMER_CLK_64MHZ
    bool "64MHZ"

config HTIMER_CLK_48MHZ
    bool "48MHZ"

endchoice


config HAL_TEST_TIMER
	bool "enable timer hal APIs test command"
		depends on DRIVERS_TIMER || DRIVERS_HTIMER
		default n
endmenu
```

## lichee/rtos-hal/hal/source/trng/Kconfig
```kconfig
menu "TRNG Devices"

config DRIVERS_TRNG
    bool "enable trng driver"
    depends on ARCH_SUN20IW2P1 || ARCH_SUN300IW1P1
        default n

config HAL_TEST_TRNG
    bool "enable trng hal APIs test command"
        depends on DRIVERS_TRNG
        default n

endmenu
```

## lichee/rtos-hal/hal/source/twi/Kconfig
```kconfig
menu "TWI Devices"

config DRIVERS_TWI
    bool "enable twi driver"
        default y

config HAL_TEST_TWI
    bool "enable twi hal APIs test command"
    depends on DRIVERS_TWI
        default n

config SUNXI_TWI_ERR_HOOK
    bool "report twi error code by hook"
    help
        report twi error code by user hook
        required function: void twi_err_report(const char *func, uint32_t line, uint32_t port, uint32_t code)
    depends on DRIVERS_TWI
        default n

config SUNXI_TWI_PORT
    int "use twi port"
    depends on DRIVERS_TWI
    default 0
endmenu
```

## lichee/rtos-hal/hal/source/uart/Kconfig
```kconfig
menu "UART Devices"

config DRIVERS_UART
    bool "enable uart driver"
        default y

config HAL_TEST_UART
    bool "enable uart hal APIs test command"
	depends on DRIVERS_UART
        default n

config SUNXI_UART_SUPPORT_POLL
    bool "support poll APIs"
	depends on DRIVERS_UART
        default n

config SUNXI_UART_REGISTER_UART0
    bool "support uart0 device"
	depends on DRIVERS_UART
        default n

config SUNXI_UART_REGISTER_UART1
    bool "support uart1 device"
	depends on DRIVERS_UART
        default n

config SUNXI_UART_REGISTER_UART2
    bool "support uart2 device"
	depends on DRIVERS_UART
        default n

config SUNXI_UART_REGISTER_UART3
    bool "support uart3 device"
	depends on DRIVERS_UART
        default n

config SUNXI_UART_REGISTER_UART4
    bool "support uart4 device"
	depends on DRIVERS_UART
        default n

config SUNXI_UART_REGISTER_UART5
    bool "support uart5 device"
	depends on DRIVERS_UART
        default n

config SUNXI_UART_REGISTER_UART6
    bool "support uart6 device"
	depends on DRIVERS_UART
        default n

config SUNXI_UART_REGISTER_UART7
    bool "support uart7 device"
	depends on DRIVERS_UART
        default n

config SUNXI_UART_REGISTER_UART8
    bool "support uart8 device"
	depends on DRIVERS_UART
        default n

config SUNXI_UART_REGISTER_UART9
    bool "support uart9 device"
	depends on DRIVERS_UART
        default n

config SUNXI_UART_REGISTER_UART10
    bool "support uart10 device"
	depends on DRIVERS_UART
        default n

config SUNXI_UART_REGISTER_UART11
    bool "support uart11 device"
	depends on DRIVERS_UART
        default n

config SUNXI_UART_REGISTER_UART12
    bool "support uart12 device"
	depends on DRIVERS_UART
        default n

config SUNXI_UART_REGISTER_UART13
    bool "support uart13 device"
	depends on DRIVERS_UART
        default n

config SUNXI_UART_REGISTER_UART14
    bool "support uart14 device"
	depends on DRIVERS_UART
        default n

config SUNXI_UART_REGISTER_UART15
    bool "support uart15 device"
	depends on DRIVERS_UART
        default n

config SUNXI_UART_REGISTER_UART16
    bool "support uart16 device"
	depends on DRIVERS_UART
        default n

config CLI_UART_PORT
    int "cli uart port number"
    depends on (DRIVERS_UART && !OS_MELIS)
        default 0

config CLI_UART_BAUD_1500000
    bool "set cli uart baud rate to 1500000"
	depends on DRIVERS_UART
        default n

config UART_DMA
    bool "support transfer uart data through dma"
    depends on DRIVERS_UART
    default n
endmenu
```

## lichee/rtos-hal/hal/source/vin/Kconfig
```kconfig
menu "VIN Devices"

config DRIVERS_VIN
    bool "enable vin driver"
    default n

config ENABLE_AIISP
    depends on DRIVERS_VIN
    bool "enable aiisp function"
    default n

if DRIVERS_VIN
choice
	depends on DRIVERS_VIN
	prompt "select isp work mode"
	default ISP_READ_THRESHOLD

config ISP_READ_THRESHOLD
	bool "read ae threshold from flash"

config ISP_FAST_CONVERGENCE
	bool "use HFR to make AE&AWB fast stability(HFR)"

config ISP_ONLY_HARD_LIGHTADC
	bool "use hard light_adc(GPADC)"

config ISP_HARD_LIGHTADC
	bool "use hard light_adc to make AE&AWB fast stability(GPADC&HFR)"
endchoice

config ISP_NUMBER
	int "isp support number"
	default 1
	range 1 3

config TDM_RX_BUF_NUM
	int "set tdm rx buf num for two camera"
	depends on ISP_NUMBER = 2
	default 2
	range 1 2

config TDM_RX_BUF_NUM_WITH_TWORX
	bool "set tdm rx buf num for two camera with tworx"
	depends on TDM_RX_BUF_NUM = 1
	default n

config VIN_WAIT_AMP_INIT
	bool "wait amp init finish for vin can use amp"
	depends on DRIVERS_VIN
	default n

config VIN_CONTINUE_INIT_TRY_TIMES
	int "vin contiue init try times"
	depends on VIN_WAIT_AMP_INIT
	default 200

config VIN_WAIT_AMP_INIT_SEM_TIMEOUT
	int "wait rpbuf init finish for vin event timeout"
	depends on VIN_WAIT_AMP_INIT
	default 3000

config NOT_FRAME_LOSS
	bool "use vin not frame loss"
	depends on DRIVERS_VIN
	default n

config VIDEO_SUNXI_VIN_SPECIAL
	bool "car reverse function for vin"
	depends on DRIVERS_VIN
	default n

config VIDEO_SUNXI_VIN_SPECIAL_EVENT_TIMEOUT
	int "car reverse function for vin event timeout"
	depends on VIDEO_SUNXI_VIN_SPECIAL
	default 300

config ISP_MEMRESERVE_ADDR
	hex "buffer addr for isp dma reg use"
	depends on DRIVERS_VIN
	default 0x43000000

config ISP_MEMRESERVE_LEN
	hex "buffer len for isp dma reg use"
	default 0x19000

config VIN_USE_SYSCONFIG
	bool "get the configuration from sysconfig"
	depends on DRIVERS_VIN
	default n

config SENSOR_INIT_BEFORE_VIN
	bool "sensor init in sram"
	depends on DRIVERS_VIN
	default n

config VIN_USE_PM
	bool "enable the sleep wake function"
	depends on COMPONENTS_PM
	depends on DRIVERS_VIN
	default n

menu "sensor driver select"
source "drivers/rtos-hal/hal/source/vin/modules/sensor/Kconfig"
endmenu

endif

endmenu
```

## lichee/rtos-hal/hal/source/vin/modules/sensor/Kconfig
```kconfig
config SENSOR_GC1054_MIPI
	bool "use gc1054_mipi driver"
	default n

config SENSOR_GC1084_MIPI
	bool "use gc1084_mipi driver"
	default n

config SENSOR_GC1084_8BIT_MIPI
	bool "use gc1084_mipi 8bit"
	depends on SENSOR_GC1084_MIPI
	default n

config SENSOR_GC1084_MIPI_USE_SAME_TWI
	bool "use gc1084_mipi use same twi and work together"
	depends on SENSOR_GC1084_MIPI
	default n

config SENSOR_GC2053_MIPI
	bool "use gc2053_mipi driver"
	default n

config SENSOR_GC2053_8BIT_MIPI
	bool "use gc2053_mipi 8bit"
	depends on SENSOR_GC2053_MIPI
	default n

config SENSOR_GC2083_MIPI
	bool "use gc2083_mipi driver"
	default n

config SENSOR_GC2083_MIPI_USE_1LANE
	bool "use gc2083_mipi use 1lane when work together"
	depends on SENSOR_GC2083_MIPI
	default n

config SENSOR_GC2083_SM_VSYNC_MODE
	bool "use gc2083_mipi use 1lane when sm_vs mode"
	depends on SENSOR_GC2083_MIPI_USE_1LANE
	default n

config SENSOR_GC4663_MIPI
	bool "use gc4663_mipi driver"
	default n

config SENSOR_GC05A2_MIPI
	bool "use gc05a2_mipi driver"
	default n

config SENSOR_IMX219_MIPI
	bool "use imx219_mipi driver"
	default n

config SENSOR_IMX219_VERTICAL
	bool "use imx219_mipi driver vertical parameter"
	depends on SENSOR_IMX219_MIPI
	default n

config SENSOR_SC2355_MIPI
	bool "use sc2355_mipi driver"
	default n

config SENSOR_SC2331_MIPI
	bool "use sc2331_mipi driver"
	default n

config SENSOR_SC2336_MIPI
	bool "use sc2336_mipi driver"
	default n

config SENSOR_SC2337P_MIPI
	bool "use sc2337p_mipi driver"
	default n

config SENSOR_SC2337P_SYNCHR_OUTPUT
	depends on SENSOR_SC2337P_MIPI
	bool "use sc2337p syncchr output"
	default n

config SENSOR_SC2337P_MULTIPLEXES_RESET
	depends on SENSOR_SC2337P_MIPI
	bool "sc2337p multiplexes RESET"
	default n

choice
	depends on SENSOR_SC2337P_SYNCHR_OUTPUT
	prompt "sc2337p synchr output"

config SENSOR_SC2337P_MASTER_SLAVE_SYNCHR_OUTPUT
	bool "sc2337p set master slave synchr output"

config SENSOR_SC2337P_MASTER_SYNCHR_OUTPUT
	bool "sc2337p set master synchr output"
endchoice

config SENSOR_SC2337P_STREAMON_IN_KERNEL
	depends on SENSOR_SC2337P_MASTER_SLAVE_SYNCHR_OUTPUT
	bool "set sc2337p streamon in kernel"
	default n

config SENSOR_SC3336_MIPI
	bool "use sc3336_mipi driver"
	default n

config SENSOR_SC500AI_MIPI
	bool "use sc500ai_mipi driver"
	default n

config SENSOR_SC5336_MIPI
	bool "use sc5336_mipi driver"
	default n

config SENSOR_TP9950_MIPI
	bool "use tp9950_mipi driver"
	default n

config SENSOR_TP9953_DVP
	bool "use tp9953_dvp driver"
	default n

config SENSOR_IMX319_MIPI
	bool "use imx319_mipi driver"
	default n

config SENSOR_IMX335_MIPI
	bool "use imx335_mipi driver"
	default n

config SENSOR_SC035HGS_MIPI
	bool "use sc035hgs_mipi driver"
	default n

config SENSOR_TP2815_MIPI
	bool "use tp2815_mipi driver"
	default n

config SENSOR_GC0406_MIPI
	bool "use gc0406_mipi driver"
	default n

config SENSOR_BF2253L_MIPI
	bool "use bf2253l_mipi driver"
	default n

config SENSOR_N5_DVP
	tristate "use n5_dvp driver"
	default n

config SENSOR_BF2257CS_MIPI
	tristate "use bf2257cs_mipi driver"
	default n

config SENSOR_F355P_MIPI
	tristate "use f355p_mipi driver"
	default n

config SENSOR_F355P_DVP
	tristate "use f355p_dvp driver"
	default n

config SENSOR_F37P_DVP
	tristate "use f37p_dvp driver"
	default n

config SENSOR_F37P_MIPI
	tristate "use f37p_mipi driver"
	default n

config SENSOR_OV02B10_MIPI
	tristate "use ov02b10_mipi driver"
	default n
```

## lichee/rtos-hal/hal/source/wupio/Kconfig
```kconfig
menu "WUPIO Devices"

config DRIVERS_WUPIO
    bool "enable wupio driver"
	depends on ARCH_SUN300IW1
        default n

endmenu
```

## lichee/rtos-hal/hal/source/wuptimer/Kconfig
```kconfig
menu "WUPTIMER Devices"

config DRIVERS_WUPTIMER
    bool "enable wuptimer driver"
	depends on ARCH_SUN300IW1
        default y

endmenu
```

## lichee/rtos/amp-spl/Kconfig
```kconfig
mainmenu "amp boot0 Config"

source "arch/Kconfig"

source "driver/Kconfig"

source "board/Kconfig"
```
