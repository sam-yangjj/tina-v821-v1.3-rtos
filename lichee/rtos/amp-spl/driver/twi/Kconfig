## lichee/rtos/amp-spl/driver/twi/Kconfig
```kconfig
menuconfig TWI_USED
	def_bool n
	prompt "TWI used"

if TWI_USED
config TWI_DEBUG
	bool "twi debug"
	default n
endif
```

## lichee/rtos/amp-spl/driver/uart/Kconfig
```kconfig
menuconfig UART_USED
	bool "uart used"

if UART_USED
config UART_BAUD
	int "uart baudrate"
	default 115200

config UART_PARITY
	int "uart parity"
	default 0
	range 0 3
	help
	  0,2 no parity
	  1 odd parity
	  3 even parity

config UART_STOP
	int "uart stop bit"
	default 0
	range 0 1
	help
	  0 - 1bit, 1 - 2(or1.5)bits

config UART_DATELEN
	int "uart datalen"
	default 3
	range 0 3
	help
	  0 - 5bits, 1 - 6bits, 2 - 7bits, 3 - 8bits
endif
```

## lichee/rtos/amp-spl/driver/vin/Kconfig
```kconfig
menu VIN_USED

config VIN_USED
    bool "enable vin driver"
    default n

if VIN_USED

config SENSOR_NUMBER
	int "isp support number"
	default 1
	range 1 2

menu "sensor driver select"
source "driver/vin/sensor/Kconfig"
endmenu

endif

endmenu
```

## lichee/rtos/amp-spl/driver/vin/sensor/Kconfig
```kconfig
config SENSOR_OV7251_MIPI
	bool "use ov7251_mipi driver"
	default n

config SENSOR_GC1084_MIPI
	bool "use gc1084_mipi driver"
	default n

config SENSOR_GC1084_MIPI_USE_SAME_TWI
	bool "use gc1084_mipi use same twi and work together"
	depends on SENSOR_GC1084_MIPI
	default n


choice
	depends on SENSOR_GC1084_MIPI
		prompt "gc1084 fps chioce"
		default GC1084_30FPS
config SENSOR_HIGH_FPS
	bool "use sensor high frame rate mode"

config GC1084_30FPS
	bool "gc1084 720p30fps"

config GC1084_15FPS
	bool "gc1084 720p15fps"

endchoice
```

## lichee/rtos/arch/risc-v/Kconfig
```kconfig
#
# For a description of the syntax of this configuration file,
# see misc/tools/kconfig-language.txt.
#

if ARCH_RISCV

comment "RISCV Options"

menu "sunxi platform"

config ARCH_SUN300IW1
	bool "allwinner sun300iw1"
	select ARCH_RISCV_E907
	default n

endmenu

config ARCH_RISCV_E907
	bool
	select ARCH_RISCV_RV32
	select LITTLE_ENDIAN

config ARCH_RISCV_RV64
	bool

config ARCH_RISCV_RV32
	bool

config TOOLCHAIN_CPU
	string
	default ""

choice
	prompt "Floating point ABI"
	default TOOLCHAIN_RISCV_FLOAT_SOFT

config TOOLCHAIN_RISCV_FLOAT_HARD
	bool "hardfp"
	select TOOLCHAIN_FLOAT_HARD

config TOOLCHAIN_RISCV_FLOAT_SOFTFP
	bool "softfp"
	select TOOLCHAIN_FLOAT_SOFTFP

config TOOLCHAIN_RISCV_FLOAT_SOFT
	bool "soft"
	select TOOLCHAIN_FLOAT_SOFT

config TOOLCHAIN_RISCV_FLOAT_NONE
	bool "none"
	select TOOLCHAIN_FLOAT_NONE

endchoice

config TOOLCHAIN_MACH_FLAGS
	string "toolchain arch cflags"
	default "-mcmodel=medany -mabi=lp64d -march=rv64gcxthead"

config TOOLCHAIN_LD_FLAGS
	string
	default "-melf32lriscv" if ARCH_RISCV_RV32

config TOOLCHAIN_MFPU
	string
	default ""

config TOOLCHAIN_FPU_ABI
	string
	default "-march=rv64gcxthead" if TOOLCHAIN_FLOAT_SOFT
	default "-march=rv64gcxthead" if TOOLCHAIN_FLOAT_SOFTFP
	default "-march=rv64gcxthead" if TOOLCHAIN_FLOAT_HARD
	default "" if TOOLCHAIN_FLOAT_NONE

config ARCH_RISCV_FPU
	bool "FPU support"
	default y
	---help---
		Build in support for the RISC-V Floating Point Unit (FPU).
		Check your chip specifications first; not all RISC-V chips support the FPU.

config SAVE_RISCV_FPU_CONTEXT_IN_TCB
	bool "Save RISC-V FPU context in thread TCB"
	depends on ARCH_RISCV_FPU
	default y
	---help---
		When enable this configuration, the system will skip FPU context save/restore
		opertaion on some unnecessary situation, you'd better enable this config unless
		the FPU work abnormally after enable this config.

config RECORD_RISCV_FPU_CTX_STATISTICS
	bool "Record RISC-V FPU context save/restore statistics info for debug"
	depends on SAVE_RISCV_FPU_CONTEXT_IN_TCB
	default n
	---help---
		Record RISC-V FPU context save/restore operation(skip situation) statistics info.

config ARCH_RISCV_PMU
    bool "RISC-V PMU Support"
    default n

config ARCH_HAVE_MMU
    bool "MMU Support"
	default n

config ARCH_HAVE_DCACHE
    bool "DCache Support"
	default n

config ARCH_HAVE_ICACHE
    bool "ICache Support"
	default n

menuconfig ARCH_RISCV_PMP
	bool "RISC-V PMP Support"
	default n

menuconfig ARCH_RISCV_ECC_INJECT
	bool "RISC-V ecc error inject test"
	default n

if ARCH_RISCV_PMP
config PMP_EARLY_ENABLE
	bool "enable PMP early"
	default n
config PMP_REGIONS
	int "Max PMP Regions"
	default 8
config PMP_ADDR_ALIGN
	int "addr align"
	default 128 if ARCH_RISCV_E906
	default 4096 if ARCH_RISCV_C906
choice
	prompt "pmp mode"
	default PMP_USE_TOR_MODE
config PMP_USE_TOR_MODE
	bool "tor mode"
config PMP_USE_NAPOT_MODE
	bool "napot mode"
endchoice

config PMP_DEBUG_CONFIG_SEQUENCE
	bool "Debug PMP configuration sequence"
	default n
	help
	  Debug PMP configuration sequence. When this config enable, the system will
	  record the PMP configuration info, and you can get these record info to analysis
	  whether the PMP configuration sequence is correct.

config PMP_CONFIG_RECORD_NUM
	int "PMP configuration record num"
	depends on PMP_DEBUG_CONFIG_SEQUENCE
	default 16

endif

config GEN_DIGEST
	bool "genterate .digest segment"
	default n

if GEN_DIGEST
choice
        prompt "verify methon"
        config	VERIFY_MD5
                bool "MD5"
        config VERIFY_CRC32
                bool "CRC32"
endchoice
endif

config ARCH_TIMER_HZ
	int "Arch Timer Frequency"
	default 24000000
	help
	  This timer is used for rtos system ticking clock

menuconfig ARCH_RISCV_INTERRUPT_NEST
	bool "interrupt nest support"
	depends on ARCH_RISCV_E906 || ARCH_RISCV_E907
	default n

if ARCH_RISCV_INTERRUPT_NEST
config SET_CLICINTCTL_NLBITS
	int "CLICINTCTL.nlbits"
	depends on ARCH_RISCV_E906 || ARCH_RISCV_E907
	default 2
	help
	  Determine the valid bit for interrupt level.
	  The value should not be larger than the platform fixed CLICINTCTLBITS.

config INTERRUPT_NEST_STACK
	int "interrupt nest stack(byte)"
	default 1152
	help
	  Number of interrupt nest * Context size

menuconfig INTERRUPT_NEST_DEBUG
	bool "interrupt nest debug"
	default n

if INTERRUPT_NEST_DEBUG
config INTERRUPT_NEST_DEBUG_LOG
	bool "nest debug log"
	default n
	help
	  Enable CLIC debug log for intterrupt nest.

endif
endif

endif
```

## lichee/rtos/components/aw/Kconfig
```kconfig
source components/aw/watchpoint/Kconfig
source components/aw/memleak/Kconfig
source components/aw/bluetooth/Kconfig
source components/aw/newlibc/Kconfig
source components/aw/kasan/Kconfig
```

## lichee/rtos/components/aw/bluetooth/Kconfig
```kconfig
menu "aw bluetooth"

config AW_COMPONENT_ETF
    bool "etf"
    default n
    help
      support etf test.

config AW_COMPONENT_BLUEDROID_OLD
    bool "bluedroid old"
    default n
    help
      support bluedroid_old test.

config AW_COMPONENT_BLUEDROID
    bool "bluedroid"
    default n
    help
      support bluedroid test.

#menuconfig ZEPHYR_BLE
#	bool "Zephyr BLE Host"
#	default n
#	help
#	  This option enables BLE Host support.

config AW_COMPONENT_BLUEDROID_CTRL
    bool "bluedroid ctrl"
    default n
    help
      support bluedroid ctrl test.

config AW_COMPONENT_XBTC_UART
    bool "bluetooth uart"
    default n
    help
      support bluetooth uart control.

#if ZEPHYR_BLE

#source "components/aw/bluetooth/zephyr/Kconfig"

#endif

endmenu
```

## lichee/rtos/components/aw/newlibc/Kconfig
```kconfig
menu "Newlibc Components Support"

config ARCH_MEMCPY_OPTIMIZE
    bool "Tina RTOS Memcpy Optimize"
    default y

config HEAP_TRACE
    bool "heap trace"
    default n

config ARCH_STRING_OPTIMIZE
    bool "Tina RTOS string Optimize"
    default n
endmenu
```

## lichee/rtos/components/thirdparty/Kconfig
```kconfig
source components/thirdparty/common/Kconfig
source components/thirdparty/console/Kconfig
source components/thirdparty/cplusplus/Kconfig
source components/thirdparty/vfs/Kconfig
```

## lichee/rtos/components/thirdparty/common/Kconfig
```kconfig
menu "common component"

config COMPONENT_COMMON
    bool "printf support"
    default y

choice
    prompt "printf selection"
    default NEWLIBC_PRINTF

    config NEWLIBC_PRINTF
        bool "newlibc printf"

    config TINY_PRINTF
        bool "tiny printf"

endchoice

config PRINTF_WITH_TIMESTAMP
    bool "printf with timestamp"
    depends on TINY_PRINTF
    default n

config CUSTOM_VSPRINTF
    bool "custom vsprintf"
    default n

endmenu
```

## lichee/rtos/components/thirdparty/console/Kconfig
```kconfig
menu "command-line interface"

config COMPONENT_CLI
    bool "command-line interface support"
    select COMPONENT_CLI_COMMANDS
    default y

config COMPONENT_CLI_COMMANDS
    bool "command-line command support"
    default y

config COMMAND_MISC
    bool "misc command"
    default y

if COMPONENT_CLI_COMMANDS

if COMMAND_MISC

config COMMAND_SAMPLE
    bool "sample command"
    default n

config COMMAND_REBOOT
    bool "reboot command"
    select DRIVERS_WATCHDOG
    select DRIVERS_RTC
    default y

config COMMAND_FORK
    bool "fork command"
    default y

config COMMAND_EFUSE_TEST
    bool "efsue_test command"
    depends on DRIVERS_EFUSE
    default n

config COMMAND_TOP
    bool "top command"
    default y

config COMMAND_MTOP
    bool "mtop command"
    select DRIVERS_MBUS
    default y

config COMMAND_VERSION
	bool "version command"
    default y

config COMMAND_REG_WRITE
	bool "register write command"
    default y

config COMMAND_REG_READ
	bool "register read command"
    default y

config COMMAND_TEST_CACHE
	bool "test cache command"
    default n

config COMMAND_HELP
	bool "help command"
    default y

config COMMAND_CLEAN
	bool "clean command"
    default y

config COMMAND_MEM_LAYOUT
	bool "memory layout command"
    default y

config COMMAND_DATE
	bool "date command"
    default y

config COMMAND_TIMEDATECTL
	bool "timectl command"
    default y

config COMMAND_TZSET
	bool "tzset command"
    default n

config COMMAND_KTIME
    bool "ktime command"
    default n

config COMMAND_FREE
	bool "free command"
    default y

config COMMAND_CLOCK_TIME
	bool "clock time command"
    default y

config COMMAND_PANIC
    bool "painc command"
    default n

config COMMAND_TASK_STATUS
    bool "task status command"
    default y

config COMMAND_DCACHE_CLEAN
    bool "dcache clean command"
    default n

config COMMAND_DCACHE_INVALIDATE
    bool "dcache invalidate command"
    default n

config COMMAND_EXEC
    bool "execute file"
    default n

endif


config COMMAND_MEMTESTER
	bool "memtester command"
    default n

config COMMAND_AUTO_START_MEMTESTER
    bool "auto start memtester for test"
    depends on COMMAND_MEMTESTER
    default n

config COMMAND_CSR
    bool "csr command"
    default n

config COMMAND_LIST_IRQ
    bool "list irq command"
    default n

if COMMAND_LIST_IRQ
config COMMAND_LIST_IRQ_ENHANCE
    bool "list irq command enhance"
    default n

config COMMAND_IRQ_DEBUG
    bool "use irq interrupt debug"
    default n
endif

endif

endmenu
```

## lichee/rtos/drivers/Kconfig
```kconfig
comment "Configure all required driver sub-systems"

menu "soc related device drivers"

config DRIVERS_CHIP
    bool
    default y

source drivers/rtos-hal/hal/source/common/Kconfig

source drivers/rtos-hal/hal/source/timer/Kconfig

source drivers/rtos-hal/hal/source/rtc/Kconfig

source drivers/rtos-hal/hal/source/watchdog/Kconfig

source drivers/rtos-hal/hal/source/uart/Kconfig

source drivers/rtos-hal/hal/source/lpuart/Kconfig

source drivers/rtos-hal/hal/source/gpadc/Kconfig

source drivers/rtos-hal/hal/source/pwm_ng/Kconfig

source drivers/rtos-hal/hal/source/sysctl/Kconfig

source drivers/rtos-hal/hal/source/gpio/Kconfig

source drivers/rtos-hal/hal/source/dma/Kconfig

source drivers/rtos-hal/hal/source/efuse/Kconfig

source drivers/rtos-hal/hal/source/ccu/Kconfig

source drivers/rtos-hal/hal/source/twi/Kconfig

source drivers/rtos-hal/hal/source/prcm/Kconfig

source drivers/rtos-hal/hal/source/hwspinlock/Kconfig

source drivers/rtos-hal/hal/source/trng/Kconfig

source drivers/rtos-hal/hal/source/msgbox/Kconfig

source drivers/rtos-hal/hal/source/vin/Kconfig

source drivers/rtos-hal/hal/source/rtc_watchdog/Kconfig

source drivers/rtos-hal/hal/source/wuptimer/Kconfig

source drivers/rtos-hal/hal/source/wupio/Kconfig

source drivers/rtos-hal/hal/source/chips/Kconfig

endmenu

menu "other drivers"
config DRIVERS_DRV
    bool
    default y

source drivers/drv/Kconfig

endmenu
```

## lichee/rtos/drivers/drv/Kconfig
```kconfig
source drivers/drv/wireless/Kconfig
source drivers/drv/uart/Kconfig
source drivers/drv/bluetooth/Kconfig
```

## lichee/rtos/drivers/drv/bluetooth/driver/controller/xradio/Kconfig
```kconfig
choice
	prompt "XRADIO Driver Controller"
	default SUN300IW1_BT_CONTROLLER

config SUN20IW2_BT_CONTROLLER
	bool "SUN20IW2 BT Controller"
	help
	  If this option is enabled, Xradio Sun20iw2 BT Controller is used.

config SUN300IW1_BT_CONTROLLER
	bool "SUN300IW1 BT Controller"
	help
	  If this option is enabled, Xradio Sun300iw1 BLE Controller is used.
endchoice

if SUN20IW2_BT_CONTROLLER
menu "sun20iw2 bt controller"
	source drivers/drv/bluetooth/driver/controller/xradio/sun20iw2/Kconfig
endmenu
endif

if SUN300IW1_BT_CONTROLLER
menu "sun300iw1 bt controller"
	source drivers/drv/bluetooth/driver/controller/xradio/sun300iw1/Kconfig
endmenu
endif
```

## lichee/rtos/drivers/drv/bluetooth/driver/controller/xradio/sun300iw1/Kconfig
```kconfig
choice
	prompt "Sun300iw1 Driver Controller"
	default DRIVER_SUN300IW1_BT_CONTROLLER_BLINK_BLE_ONLY

config DRIVER_SUN300IW1_BT_CONTROLLER_BLE_ONLY
	bool "Sun300iw1 BLE Only Controller"
	help
	  If this option is enabled, Sun300iw1 BLE only Controller is used.

config DRIVER_SUN300IW1_BT_CONTROLLER_BLINK_BLE_ONLY
	bool "Sun300iw1 BLE Only blink Controller"
	help
	  If this option is enabled, Sun300iw1 BLE only for blink Controller is used.

endchoice
```

## lichee/rtos/drivers/drv/bluetooth/driver/interface/Kconfig
```kconfig
choice
	prompt "Bluetooth Driver Interface"
	default BT_VHCI

config BT_VHCI
	bool "Virtual HCI"
	help
	  If this option is enabled, virtual hci is used.

config BT_UART
	bool "UART HCI"
	help
	  If this option is enabled, uart hci is used.

endchoice

config COMPONENTS_AMP_BT
	bool "Blutooth AMP connect"
	default y
	help
	  this will set blutooth AMP connect type.
```

## lichee/rtos/drivers/drv/wireless/Kconfig
```kconfig
menuconfig DRIVERS_WIRELESS
	default n
	bool "wireless devices"

if DRIVERS_WIRELESS

config DRIVERS_V821_USE_SIP_WIFI
	bool "enable smac mode"
	default n
	depends on ARCH_SUN300IW1P1
	help
		linux use phy.a on smac mode

source drivers/drv/wireless/xradio/Kconfig

choice XRADIO_WLAN_PHY_COMP_TYPE
	default XRADIO_WLAN_PHY_COMP_USE_LIB
	prompt "Xradio wifi use phy.a or phy.bin"
	depends on DRIVERS_V821_USE_SIP_WIFI || DRIVER_V821
	help
		Xradio wifi use phy.a or phy.bin.

config XRADIO_WLAN_PHY_COMP_USE_LIB
	bool "Xradio wifi use phy.a"
	help
		Xradio wifi use phy.a.

config XRADIO_WLAN_PHY_COMP_USE_BIN
	bool "Xradio wifi use phy.bin"
	select WLAN_PHY_CALL_BY_RTOS
	select WLAN_PHY_BIN_ENABLE
	help
		Xradio wifi use phy.bin.
endchoice

if XRADIO_WLAN_PHY_COMP_USE_LIB
choice XRADIO_WLAN_PHY_LIB_LINK
	default XRADIO_WLAN_PHY_LIB_LINK_V821
	prompt "Link xradio which wifi phy.a"
	depends on XRADIO_WLAN_PHY_COMP_USE_LIB
	depends on DRIVERS_V821_USE_SIP_WIFI || DRIVER_V821
	help
		Link xradio wifi phy.a: V821 or V821B.
config XRADIO_WLAN_PHY_LIB_LINK_V821
	bool "Link phy_v821.a"
	help
		Link phy_v821.a.
config XRADIO_WLAN_PHY_LIB_LINK_V821B
	bool "Link phy_v821b.a"
	help
		Link phy_v821b.a.
endchoice
endif
endif #DRIVERS_WIRELESS
```
