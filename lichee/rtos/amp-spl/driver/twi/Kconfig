## lichee/rtos/drivers/drv/wireless/xradio/Kconfig
```kconfig
#
# Wlan configuration
#

menuconfig DRIVERS_XRADIO
	default n
	select COMPONENTS_MBEDTLS
	bool "XRADIO driver"

if DRIVERS_XRADIO

config DRIVERS_XRADIO_CMD
	bool "Enable xradio test cmd"
	default y
	select NEWLIBC_NANO_SCANF_FLOAT if ARCH_SUN20IW2P1
	help
		this will use xradio test cmd.

config XRADIO_FW_KEEPALIVE_CMD
	bool "Enable xradio fw keepalive cmd"
	default y
	depends on DRIVERS_XRADIO_CMD
	help
		support fw keep alive cmd

config XRADIO_RF_CMD
	bool "Enable xradio rf cmd"
	default y
	depends on DRIVERS_XRADIO_CMD
	help
		support rf cmd

config WLAN_RAW_PACKET_FEATURE
	bool "Enable RAW packet send and recv cmd"
	default y
	select WLAN_SUPPORT_EXPAND_CMD if ARCH_SUN300IW1
	help
		this will use xradio RAW packet send and recv cmd.

choice XRADIO_CHIP
	default DRIVER_V821 if ARCH_SUN300IW1P1
	default DRIVER_R128 if ARCH_SUN20IW2P1
	default DRIVER_XR829
	prompt "Xradio chip"
	help
		Specify the xradio chip.

config DRIVER_XR819
	bool "Enable xr819 driver"
	depends on DRIVERS_XRADIO
	help
		this will use xr819 chip.

config DRIVER_XR819S
	bool "Enable xr819s driver"
	depends on DRIVERS_XRADIO
	help
		this will use xr819s chip.

config DRIVER_XR829
	bool "Enable xr829 driver"
	depends on DRIVERS_XRADIO
	help
		this will use xr829 chip.

config DRIVER_R128
	bool "Enable r128 driver"
	depends on ARCH_SUN20IW2P1
	help
		this will use r128 chip.

config DRIVER_V821
	bool "Enable v821 driver"
	depends on ARCH_SUN300IW1P1
	help
		this will use v821 chip.

endchoice

config XR829_40M_FW
	bool "Use Firmware 40M for XR829"
	depends on DRIVER_XR829
	default y
	help
		this will use xr829 chip

config XR819S_40M_FW
    bool "Use Firmware 40M for XR819S"
    depends on DRIVER_XR819S
    default y
    help
               this will use xr819s chip
# Wi-Fi Certification of WFA
config WIFI_CERTIFIED
    bool "Wi-Fi Certification of WFA"
    default y
    help
        If this option is enabled,  Wi-Fi Certification of WFA used.

# v821 wlan dual core enable
config MUTIL_NET_STACK
    bool "v821 wlan dual core"
    depends on DRIVER_V821
    default y
    help
        If this option is enabled, v821 mutil net stack used.

if MUTIL_NET_STACK
config INIT_NET_STACK
    bool "default init xradio dual net stack"
    depends on MUTIL_NET_STACK
    default n
    help
        If this option is enabled, v821 will init xrlink when system start.

# v821 wlan rpbuf perf test
config XRADIO_RPBUF_PERF_TEST
    bool "v821 xradio rpbuf perf test"
    depends on MUTIL_NET_STACK
    default n
    help
        If this option is enabled, v821 mutil net stack used.
endif

# wlan station mode
config WLAN_STA
    bool "wlan station mode"
    default y
    help
        If this option is enabled, WLAN STA mode used.

config WLAN_STA_WPS
    bool "wlan station mode with wps support"
	depends on WLAN_STA
    default n
    help
        If this option is enabled, WLAN STA WPS used.

choice XRADIO_STA_PS_MODE
	default WLAN_STA_AUTO_PS_MODE if ARCH_SUN300IW1P1
	default WLAN_STA_FORCE_PS_MODE
	prompt "Xradio sta PS mode"
	depends on WLAN_STA
	help
		Specify the xradio sta PS mode.

config WLAN_STA_AUTO_PS_MODE
	bool "STA in Active/PS mode by chip type"
	depends on WLAN_STA
	help
		STA in Active/PS mode by chip type(efuse...).

config WLAN_STA_FORCE_ACTIVE_MODE
	bool "STA in Active mode"
	depends on WLAN_STA
	help
		STA in Active mode.

config WLAN_STA_FORCE_PS_MODE
	bool "STA in PS mode"
	depends on WLAN_STA
	help
		STA will enter PS mode.
endchoice

config WLAN_STA_FREQ_AUTO_ALIGN
    bool "wlan station mode use freq auto align ap"
	depends on WLAN_STA
    default y if ARCH_SUN300IW1P1
    default n
    help
        If this option is enabled, WLAN STA enable freq auto align ap func.

config BT_CLOSE_WLAN_FREQ_AUTO_ALIGN
    bool "bt close freq auto align ap"
	depends on WLAN_STA_FREQ_AUTO_ALIGN
	depends on CHIP_V821B
    default n
    help
        If this option is enabled, bt open will disable freq auto align ap func.

# wlan monitor mode
config WLAN_MONITOR
    bool "wlan monitor mode"
    default y
    select WLAN_SUPPORT_EXPAND_CMD if ARCH_SUN300IW1
    help
        If this option is enabled, WLAN Monitor mode used.

# wlan hostap mode
config WLAN_AP
    bool "wlan ap mode"
    default y
    select COMPONENTS_SERVICE_UDHCPD
    help
        If this option is enabled, WLAN AP mode used.

config WLAN_AP_SNIFFER
	bool "wlan ap sniffer mode"
	default n
	depends on WLAN_MONITOR
	depends on WLAN_AP
	help
		If this option is enabled, WLAN AP sniffer mode used.

# wlan station mode and softap mode coexist
config STA_SOFTAP_COEXIST
    bool "wlan STA and SoftAp coexist"
    depends on WLAN_STA
    depends on WLAN_AP
    default n
    help
        enabled station mode and softap mode coexistence.

config FREQ_TRIM_FROM_SDD
	bool "freq trim from SDD first"
	depends on ARCH_SUN20IW2P1
	default n
	help
		obtain freq trim/offset value from SDD file and config it into system,
		when this option selected, the priority will be higher than CONFIG_DCXO_FREQ_TRIM

# wlan ETF test using ETF command line interface
config ETF_CLI
    bool
    default n

# wlan ETF test
config ETF
    bool "wlan ETF test"
	select ETF_CLI
	select NEWLIBC_NANO_SCANF_FLOAT if ARCH_SUN20IW2P1
	select NEWLIBC_NANO_PRINTF_FLOAT if ARCH_SUN20IW2P1
	#select WLAN_SHARE_RAM
	#select WLAN_SHARE_RAM_SIZE_128K
    default n
    help
        If this option is enabled, WLAN ETF test used.

# Wlan use small stack
config WLAN_SMALL_STACK_SIZE
	bool
	default n
	help
		use small stack in some CPU ARCH.

# Mbuf implementation mode
config MBUF_IMPL_MODE
	int
	default 0
	help
		0: continuous memory allocated from heap, 1: continuous memory allocated from lwip pbuf.

config WLAN_SUPPORT_EXPAND_CMD
	bool "support wifimanager exp cmd"
	default y
	depends on ARCH_SUN300IW1
	depends on INIT_NET_STACK
	help
		support linux use e907 wlan cmd, wifimanager must enable CONFIG_WMG_SUPPORT_EXPAND

config SUPPORT_EXP_LMAC_CMD
	bool "lmac"
	default y
	depends on WLAN_SUPPORT_EXPAND_CMD
	help
		support expand lmac cmd

config SUPPORT_EXP_RF_CMD
	bool "rf"
	default y
	depends on WLAN_SUPPORT_EXPAND_CMD
	help
		support expand rf cmd

config XR_WF_SW_FW_BUF_DISABLE
	bool "disable wf switch fw buf"
	default n
	depends on ARCH_SUN300IW1P1
	depends on CHIP_V821B
	help
		force disable wf switch fw buf

endif
```

## lichee/rtos/kernel/Kconfig
```kconfig
config KERNEL_FREERTOS
    bool "support freertos kernel"
    default y

if KERNEL_FREERTOS
choice
	prompt "Build freertos version"
	default FREERTOS_V10_4_3

config FREERTOS_V10_4_3
	bool "freertos v10.4.3"
endchoice
endif

config KERNEL_FREERTOS_PLUS_POSIX
    bool "support posix"
    default y

if KERNEL_FREERTOS_PLUS_POSIX
config PTHREAD_SUPPORT_THREAD_LOCAL_STORAGE
    bool "support thread local storage(TLS)"
    default y if TOOLCHAIN="tools/Xuantie-900-gcc-elf-newlib-x86_64-V2.10.1/bin/riscv64-unknown-elf-" && COMPONENT_CPLUSPLUS
    default n

config PTHREAD_TLS_KEY_MAX_NUM
    int "Maximum TLS key number"
    depends on PTHREAD_SUPPORT_THREAD_LOCAL_STORAGE
    default 8
endif # if KERNEL_FREERTOS_PLUS_POSIX

choice
prompt "Heap Memory Manager"
default	HEAP_4

config	HEAP_4
	bool "Use heap-4 to allocate memory"

endchoice

config DYNAMIC_HEAP_SIZE
	bool "dynamic default heap size"
	default y


choice
prompt "Backtrace Select"
default DEBUG_BACKTRACE

config DEBUG_BACKTRACE
    bool "debug backtrace by machine code"
	help
	backtrace by parsing machine code

config DEBUG_BACKTRACE_FRAME_POINTER
    bool "debug backtrace by frame pointer"
	help
	backtrace by frame pointer

config DEBUG_BACKTRACE_NONE
    bool "no backtrace"
	help
	no backtrace

endchoice

config EXCEPTION_CAUSE_STR
    bool "enable exception cause str"
    default y

config TOTAL_HEAP_SIZE
    hex "total heap size (bytes)"
    default 0x1000000

config HEAP_MIN_ALIGNMENT_SIZE
    int "heap min alignment size (bytes)"
    default 8

config HZ
    int "Tick frequency, Hz"
    range 10 1000
    default 1000 if SMP
    help
    System's tick frequency, Hz.

config OS_USE_IDLE_HOOK
	bool "idle hook"
	default y

choice
prompt "Io Lock"
default UART_CLI_USE_MUTEX

config UART_CLI_USE_NONE
	bool "Lock None"

config UART_CLI_USE_MUTEX
	bool "Use Mutex"

config UART_CLI_USE_SPINLOCK
	bool "Use SpinLock"

endchoice

menuconfig KERNEL_COMPRESS
	bool "kernel Compress Support"
	default n
	depends on ARCH_RISCV

if KERNEL_COMPRESS
config KERNEL_COMPRESS_DEBUG
	bool "Debug"
	default n

choice
	prompt "Compress kernel format"
	config KERNEL_COMPRESS_ELF
		bool "elf"
	config KERNEL_COMPRESS_BIN
		bool "bin"
endchoice

if KERNEL_COMPRESS_ELF
config KERNEL_COMPRESS_LOADADDR
	hex "ELF decompress addr"
	default 0
	help
		if =0,will auto select load addr
endif

choice
	prompt "Compress methon"
	config KERNEL_COMPRESS_GZIP
		bool "GZIP"
	config KERNEL_COMPRESS_LZO
		bool "LZO"
	config KERNEL_COMPRESS_LZMA
		bool "LZMA"
	config KERNEL_COMPRESS_XZ
		bool "XZ"
		select XZ_DEC_BCJ
		select XZ_DEC_RISCV if RISCV
		select XZ_DEC_ARM if ARM
	config KERNEL_COMPRESS_LZ4
		bool "LZ4"
endchoice
endif
```

## lichee/rtos/projects/Kconfig
```kconfig
choice
    prompt "Configure Application"
    default PROJECT_R328S1_EVB1_DEMO

config PROJECT_V821_E907_VER1
	bool "v821 e907 ver1 system"
	select PROJECT_V821_E907
	---help---
		v821 e907 ver1 system

config PROJECT_V821_E907_IPC
	bool "v821 e907 ipc system"
	select PROJECT_V821_E907
	---help---
		v821 e907 ipc system

config PROJECT_V821_E907_PERF2
	bool "v821 e907 perf2 system"
	select PROJECT_V821_E907
	---help---
		v821 e907 perf2 system

config PROJECT_V821_E907_AIGLASS
	bool "v821 e907 aiglass  system"
	select PROJECT_V821_E907
	---help---
		v821 e907 aiglass system

config PROJECT_V821_E907_PERF2_FASTBOOT
	bool "v821 e907 perf2 fastboot system"
	select PROJECT_V821_E907
	---help---
		v821 e907 perf2 fastboot system

config PROJECT_V821_E907_QA_WXX
	bool "v821 e907 qa_wxx system"
	select PROJECT_V821_E907
	---help---
		v821 e907 qa_wxx system(etf)

config PROJECT_V821_E907_QA_EXX
	bool "v821 e907 qa_exx system"
	select PROJECT_V821_E907
	---help---
		v821 e907 qa_exx system(etf)

config PROJECT_V821_E907_QA_XXX
	bool "v821 e907 qa_xxx system"
	select PROJECT_V821_E907
	---help---
		v821 e907 qa_xxx system(etf)

config PROJECT_V821_E907_PERF2B_FASTBOOT
    bool "v821_e907 perf2b_fastboot system"
    select PROJECT_V821_E907
    ---help---
        the v821_e907 perf2b_fastboot system

config PROJECT_V821_E907_PERF2B
    bool "v821_e907 perf2b system"
    select PROJECT_V821_E907
    ---help---
        the v821_e907 perf2b system

config PROJECT_V821_E907_SC1745V
    bool "v821_e907 sc1745v system"
    select PROJECT_V821_E907
    ---help---
        the v821_e907 sc1745v system

config PROJECT_V821_E907_PERF5
    bool "v821_e907 perf5 system"
    select PROJECT_V821_E907
    ---help---
        the v821_e907 perf5 system

config PROJECT_V821_E907_TUYA_FASTBOOT
    bool "v821_e907 tuya_fastboot system"
    select PROJECT_V821_E907
    ---help---
        the v821_e907 tuya_fastboot system

config PROJECT_V821_E907_PERF2B_LOWPOWER
    bool "v821_e907 perf2b_lowpower system"
    select PROJECT_V821_E907
    ---help---
        the v821_e907 perf2b_lowpower system

config PROJECT_V821_E907_AVAOTA_F1
    bool "v821_e907 avaota_f1 system"
    select PROJECT_V821_E907
    ---help---
        the v821_e907 avaota_f1 system

endchoice

config PROJECT_V821_E907
    bool
    select SUNXI_CHIPS

config FPGA_PLATFORM
    bool "Run on fpga"
    default n

config PROJECT_TESTCASE
    bool "Project Testcase"
    default n

config NON_OS
    bool "non os demo"
    default n
    depends on PROJECT_T113_S3P_C906_EVB1_AUTO_NON_OS

if ARCH_SUN300IW1

choice
    prompt "Configure chip model"
    default CHIP_V821

config CHIP_V821
	bool "v821"
	---help---
		use v821

config CHIP_V821B
	bool "v821b"
	---help---
		usb v821b

endchoice


menuconfig WAIT_SPIF_CONTROLLER
    bool "wait for spif controller"
    default n

if WAIT_SPIF_CONTROLLER
config SPIF_WAIT_INDEX
    int "spif wait rtc data index"
    default 0
config SPIF_WAIT_BIT
    int "spif wait rtc data bit"
    default 2
endif

menuconfig PRELOAD_RAMDISK
    bool "load kernel ramdisk"
    depends on COMPONENTS_AW_FLASH_READ
    depends on RPMSG_NOTIFY
    default n

if PRELOAD_RAMDISK
config RAMDISK_LOADADDR
    hex "kernel ramdisk load address"
config RAMDISK_PARTITION_SIZE
    hex "kernel ramdisk compress size"

config RAMDISK_DECOMPRESS_ADDR
    hex "kernel ramdisk decompress address"
config RAMDISK_DECOMPRESS_SIZE
    hex "kernel ramdisk decompress size"
endif
endif

menuconfig PRELOAD_ROOTFS
    bool "load kernel rootfs"
    depends on !PRELOAD_RAMDISK
    depends on COMPONENTS_AW_FLASH_READ
    depends on RPMSG_NOTIFY
    depends on WAIT_SPIF_CONTROLLER
    depends on ARCH_SUN300IW1
    depends on COMPONENTS_SQUASHFS
    default n

if PRELOAD_ROOTFS
config PRINT_ROOTFS_LOADTIME
    bool "print load time"
    default n
config ROOTFS_LOADADDR
    hex "rootfs load address"
config ROOTFS_PARTITION_SIZE
    hex "rootfs load address size"
config ROOTFS_LOAD_FILES
    string "rootfs load file list. e.g. liba libc"
    default "lib/libc.so lib/libstdc++.so.6.0.28 lib/librt_media.so lib/libawion.so,lib/libgcc_s.so.1 bin/busybox bin/demo_video_in etc/ld-musl-riscv32.path files/init"
endif

config PRELOAD_ISP_PARAM
    bool "load isp param from flash"
    depends on COMPONENTS_AW_FLASH_READ
    default n
```
